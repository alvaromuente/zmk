## app/boards/arm/combi/Kconfig
```kconfig
# Copyright (c) 2022 Brandon Beltran
# SPDX-License-Identifier: MIT

config BOARD_ENABLE_DCDC
	bool "Enable DCDC mode"
	select SOC_DCDC_NRF52X
	default y
	depends on (BOARD_COMBI || BOARD_COMBI_PERIPHERAL)

config BOARD_COMBI_CHARGER
	bool "Enable battery charger"
	default y
	depends on (BOARD_COMBI || BOARD_COMBI_PERIPHERAL)
```

## app/boards/arm/combi/Kconfig.board
```kconfig
# Copyright (c) 2022 Brandon Beltran
# SPDX-License-Identifier: MIT

config BOARD_COMBI
	bool "combi"
	depends on SOC_NRF52840_QIAA

config BOARD_ENABLE_DCDC
	bool "Enable DCDC mode"
	select SOC_DCDC_NRF52X
	default y
	depends on BOARD_COMBI
```

## app/boards/arm/combi/Kconfig.defconfig
```kconfig
# Copyright (c) 2022 Brandon Beltran
# SPDX-License-Identifier: MIT

if BOARD_COMBI

config ZMK_KEYBOARD_NAME
	default "COMBI V3"

if USB_DEVICE_STACK

config USB_NRFX
	default y

endif # USB_DEVICE_STACK

config BT_CTLR
	default BT

config ZMK_BLE
	default y

config ZMK_USB
	default y

endif # BOARD_COMBI
```

## app/boards/arm/combi/combi_left_defconfig
```kconfig
# Copyright (c) 2022 Brandon Beltran
# SPDX-License-Identifier: MIT

CONFIG_BOARD_COMBI_LEFT=y
CONFIG_ZMK_SPLIT=y
#CONFIG_ZMK_BLE_CLEAR_BONDS_ON_START=y

CONFIG_SOC_SERIES_NRF52X=y
CONFIG_SOC_NRF52840_QIAA=y

# Enable MPU
CONFIG_ARM_MPU=y

# enable GPIO
CONFIG_GPIO=y

CONFIG_USE_DT_CODE_PARTITION=y
CONFIG_BUILD_OUTPUT_UF2=y

CONFIG_MPU_ALLOW_FLASH_WRITE=y
CONFIG_NVS=y
CONFIG_SETTINGS_NVS=y
CONFIG_FLASH=y
CONFIG_FLASH_PAGE_LAYOUT=y
CONFIG_FLASH_MAP=y
CONFIG_CLOCK_CONTROL_NRF_K32SRC_RC=y 
```
